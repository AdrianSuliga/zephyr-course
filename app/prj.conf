## CMakeLists.txt
```
cmake_minimum_required(VERSION 3.20.0)

find_package(Zephyr REQUIRED)
project(my_zephyr_app)

target_sources(app PRIVATE src/main.cpp)
add_subdirectory(drivers/our_driver/)
```

## Kconfig
```
config APP_HEARTBEAT_PERIOD_MS
    int "Config app heartbeat period (ms)"
    range 100 2000
    default 500

source "Kconfig.zephyr"
rsource "drivers/our_driver/Kconfig"
```

## prj.conf
```kconfig
CONFIG_LOG=y

#CONFIG_SHELL=y
```

## app.overlay
```dts
/ {
    aliases {
        led0 = &green_led;
    };

    our_driver0: our_driver {
        compatible = "our,driver";
        status = "okay";
    };
};
```

## dts/bindings/our,driver.yaml
```yaml
description: Our custom snesor driver binding
compatible: "our,driver"
```

## src/main.cpp
```c
#include <zephyr/drivers/sensor.h>
#include <zephyr/kernel.h>
#include <zephyr/logging/log.h>
#include <our_driver_extension.h>

LOG_MODULE_REGISTER(main, LOG_LEVEL_INF);

int main(void)
{
    while (true) {
        k_msleep(CONFIG_APP_HEARTBEAT_PERIOD_MS);
    }

    return 0;
}
```
