## app/drivers/our_driver/Kconfig
```kconfig
config OUR_DRIVER
    bool "Our Custom Driver"
    default y
    depends on DT_HAS_OUR_DRIVER_ENABLED
    select GPIO
    help
        Enable the custom driver
```

## boards/my_board/board.yml
```yaml
board:
  name: my_board
  full_name: My Board
  vendor: bebelno
  socs:
    - name: stm32f746xx
```

## boards/my_board/my_board_defconfig
```kconfig
CONFIG_ARM_MPU=y

CONFIG_HW_STACK_PROTECTION=y

CONFIG_SERIAL=y

CONFIG_CONSOLE=y
CONFIG_UART_CONSOLE=y

CONFIG_LOG=y

# STM32 requirement
CONFIG_BOARD_EARLY_INIT_HOOK=y

CONFIG_GPIO=y
```

## boards/our_board/Kconfig.defconfig
```kconfig
# STM32F746ZG Nucleo board configuration

# Copyright (c) 2018 AJ Palmer
# SPDX-License-Identifier: Apache-2.0

if BOARD_OUR_BOARD

if NETWORKING

config NET_L2_ETHERNET
	default y

endif # NETWORKING

endif # BOARD_OUR_BOARD
```

## boards/our_board/Kconfig.our_board
```kconfig
# Copyright (c) 2018 AJ Palmer
# SPDX-License-Identifier: Apache-2.0

config BOARD_OUR_BOARD
	select SOC_STM32F746XX
```

## boards/our_board/board.yml
```yaml
board:
  name: our_board
  full_name: Our Board
  vendor: bebelno
  socs:
    - name: stm32f746xx
```
